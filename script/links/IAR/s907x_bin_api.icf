define exported symbol __wlan_bss_end__ = 0x100153d4;
define exported symbol _wlan_is_running = 0x1803a115;
define exported symbol s907x_wlan_off = 0x18039671;
define exported symbol _wlan_send_mgt = 0x1803a239;
define exported symbol _wlan_get_phy_mode = 0x1803a269;
define exported symbol _wlan_get_country = 0x1803a625;
define exported symbol _wlan_add_ie = 0x1803a4f9;
define exported symbol system_init_config = 0x1801ec85;
define exported symbol _wlan_set_rtos_hookfunc = 0x1803a0f5;
define exported symbol _wlan_ap_del_sta = 0x1803a5a9;
define exported symbol _wlan_set_apnetif = 0x18038875;
define exported symbol _wlan_start_scan = 0x1803a159;
define exported symbol s907x_wlan_set_regular_cali = 0x18020069;
define exported symbol _wlan_set_stanetif = 0x18038869;
define exported symbol s907x_wlan_on = 0x18039545;
define exported symbol _wlan_set_phy_mode = 0x1803a245;
define exported symbol uart_dma_rx_addr = 0x1801d939;
define exported symbol _wlan_start_monitor = 0x1803a20d;
define exported symbol wifi_unreg_event_handler = 0x18039e19;
define exported symbol _wlan_get_autoreconnect = 0x1803a789;
define exported symbol _wlan_set_rx_mgnt_cb = 0x1803a7d5;
define exported symbol _wlan_rf_off = 0x1803a111;
define exported symbol _wlan_set_scan_channel = 0x1803a141;
define exported symbol _wlan_set_country = 0x1803a5d1;
define exported symbol _wlan_link_info = 0x1803a501;
define exported symbol pmu_yield_os_check = 0x18045cc1;
define exported symbol _wlan_start_ap_normal = 0x1803a6b5;
define exported symbol _wlan_send = 0x1801f869;
define exported symbol _wlan_enable_autoreconnect = 0x1803a771;
define exported symbol _wlan_disable_autoreconnect = 0x1803a77d;
define exported symbol _wlan_set_channel = 0x1803a135;
define exported symbol _wlan_recv = 0x1801f8e5;
define exported symbol _wlan_start_sta = 0x1803a675;
define exported symbol _wlan_set_mac_no_efuse = 0x1803a34d;
define exported symbol _wlan_set_netfunc = 0x1803884d;
define exported symbol _wlan_reg_event = 0x1803a7a9;
define exported symbol __wlan_bss_start__ = 0x1000d940;
define exported symbol s907x_set_sleeptime = 0x1803a79d;
define exported symbol _wlan_rf_on = 0x1803a10d;
define exported symbol _wlan_get_channel = 0x1803a13d;
define exported symbol wifi_rx_beacon_hdl = 0x18038409;
define exported symbol _wlan_get_mac = 0x1803a4b9;
define exported symbol _wlan_unreg_event = 0x1803a7b5;
define exported symbol s907x_wlan_get_mode = 0x1803a0e9;
define exported symbol _wlan_set_mac = 0x1803a2ad;
define exported symbol _wlan_start_ap_hidden_ssid = 0x1803a6ed;
define exported symbol _wlan_disconnect = 0x1803a1d1;
define exported symbol wifi_reg_event_handler = 0x18039dc5;
define exported symbol _wlan_set_mpmode = 0x1803a7c1;
define exported symbol _wlan_stop_ap = 0x1803a591;
define exported symbol _wlan_start_scan_ssid = 0x1803a165;
define exported symbol _wlan_get_associated = 0x1803a185;
define exported symbol _wlan_del_ie = 0x1803a4fd;
define exported symbol i2s_ll_get_pagesize = 0x1801e685;
define exported symbol sci_ll_crypto_sha1_process = 0x1801f51d;
define exported symbol sci_ll_crypto_aes_ctr_init = 0x1801f49d;
define exported symbol i2s_ll_set_direction = 0x1801e62d;
define exported symbol sci_ll_crypto_aes_cbc_decrypt = 0x1801f4cd;
define exported symbol sci_ll_crypto_hmac_md5 = 0x1801f545;
define exported symbol spi_ll_tx_allow = 0x1801e1dd;
define exported symbol rtc_ll_init = 0x1801eb45;
define exported symbol i2s_ll_set_it_enable = 0x1801e755;
define exported symbol spi_ll_get_datalen = 0x1801df9d;
define exported symbol sci_ll_crypto_sha2_init = 0x1801f535;
define exported symbol timer_ll_capture_dma_stop = 0x1801d57d;
define exported symbol spi_ll_set_speed = 0x1801e1a5;
define exported symbol spi_ll_set_itmask = 0x1801e2a9;
define exported symbol timer_ll_get_count = 0x1801d1c9;
define exported symbol sci_ll_crypto_aes_ctr_encrypt = 0x1801f48d;
define exported symbol hal_ll_dsleep_set_wakepin_event = 0x1801f1c9;
define exported symbol i2c_ll_dma_set_trx = 0x1801de99;
define exported symbol sci_ll_crypto_3des_cbc_init = 0x1801f425;
define exported symbol i2c_ll_master_write = 0x1801dc35;
define exported symbol hal_ll_start_osc32k = 0x1801f275;
define exported symbol uart_ll_get_flag = 0x1801d8a1;
define exported symbol sci_ll_crypto_des_ecb_encrypt = 0x1801f43d;
define exported symbol uart_dma_ll_rx_stop = 0x1801d94d;
define exported symbol uart_ll_cmd = 0x1801d649;
define exported symbol hal_ll_unregister_user_sleep_irq = 0x1801ed89;
define exported symbol adc_ll_cmd = 0x1801d00d;
define exported symbol pmu_ll_sleep_check_ok = 0x18045a1d;
define exported symbol uart_ll_recv_byte = 0x1801d83d;
define exported symbol ps_ll_enable2 = 0x1801f119;
define exported symbol gpio_ll_it_mask = 0x1801cf4d;
define exported symbol mem_ll_cpy = 0x1801f369;
define exported symbol uart_dma_rx_opt = 0x1801d9ed;
define exported symbol flash_ll_erase = 0x1801ee11;
define exported symbol delay_ll_us = 0x1801f3bd;
define exported symbol i2c_ll_dma_mode = 0x1801df31;
define exported symbol hal_ll_register_user_sleep_irq = 0x1801ed7d;
define exported symbol sci_ll_crypto_sha2_process = 0x1801f53d;
define exported symbol hal_ll_set_download = 0x1801f329;
define exported symbol adc_ll_poll_result = 0x1801d089;
define exported symbol system_ll_reset = 0x1801f35d;
define exported symbol gpio_ll_set_io = 0x1801ce99;
define exported symbol uart_ll_dma_config = 0x1801da2d;
define exported symbol wdg_ll_deinit = 0x1801edcd;
define exported symbol uart_ll_clr_error = 0x1801d84d;
define exported symbol spi_ll_check_busy = 0x1801e289;
define exported symbol flash_ll_write = 0x1801ee55;
define exported symbol loguart_ll_init = 0x1801eab9;
define exported symbol i2c_ll_slavor_write_it = 0x1801dce9;
define exported symbol sci_ll_crypto_hmac_sha2_init = 0x1801f595;
define exported symbol vPort_ll_SuppressTicksAndSleep = 0x18045e49;
define exported symbol uart_ll_rx_allow = 0x1801d8fd;
define exported symbol rf_ll_get_version = 0x1801ed4d;
define exported symbol sci_ll_crypto_hmac_sha1_process = 0x1801f57d;
define exported symbol i2c_ll_get_status = 0x1801dd2d;
define exported symbol timer_ll_init_base = 0x1801d28d;
define exported symbol uart_ll_tx_allow = 0x1801d8e5;
define exported symbol sci_ll_crypto_init = 0x1801f3cd;
define exported symbol sci_ll_crypto_3des_ecb_encrypt = 0x1801f465;
define exported symbol sci_ll_crypto_md5_init = 0x1801f4fd;
define exported symbol sci_ll_crypto_hmac_md5_init = 0x1801f555;
define exported symbol wdg_ll_init = 0x1801eda1;
define exported symbol i2c_ll_dma_legacy = 0x1801deed;
define exported symbol timer_ll_capture_dma = 0x1801d589;
define exported symbol sci_ll_crypto_aes_cbc_encrypt = 0x1801f4dd;
define exported symbol i2c_ll_dma_config = 0x1801df61;
define exported symbol sci_ll_crypto_aes_ecb_init = 0x1801f4c5;
define exported symbol spi_ll_get_rxfifo = 0x1801e225;
define exported symbol spi_ll_init = 0x1801e01d;
define exported symbol i2s_ll_get_isr = 0x1801e6a5;
define exported symbol adc_ll_init = 0x1801cfe9;
define exported symbol adc_ll_set_analog = 0x1801d075;
define exported symbol spi_ll_dma_config = 0x1801e3bd;
define exported symbol uart_ll_set_powerlevel = 0x1801d6d1;
define exported symbol i2s_ll_cmd = 0x1801e675;
define exported symbol user_ll_get_flash_para = 0x1801ed61;
define exported symbol sci_ll_crypto_des_ecb_decrypt = 0x1801f42d;
define exported symbol wdg_ll_stop = 0x1801eded;
define exported symbol spi_ll_dma_set_trx = 0x1801e369;
define exported symbol timer_ll_init_capture = 0x1801d5f5;
define exported symbol timer_ll_set_period = 0x1801d1fd;
define exported symbol i2c_ll_slave_read = 0x1801dc95;
define exported symbol mem_ll_set = 0x1801f371;
define exported symbol uart_ll_set_baud = 0x1801d65d;
define exported symbol uart_ll_init = 0x1801d771;
define exported symbol i2s_ll_set_trx_buf = 0x1801e7ed;
define exported symbol vs_ll_printf = 0x1801f379;
define exported symbol i2c_ll_dma_cmd = 0x1801df71;
define exported symbol spi_dma_rx_opt = 0x1801e2c9;
define exported symbol uart_ll_burst_size = 0x1801da05;
define exported symbol hal_ll_sleep_event_clear = 0x1801efc1;
define exported symbol sci_ll_crypto_3des_cbc_encrypt = 0x1801f415;
define exported symbol mem_ll_cmp = 0x1801f361;
define exported symbol i2s_ll_init_base = 0x1801e401;
define exported symbol gpio_ll_init = 0x1801cdb1;
define exported symbol sci_ll_crypto_3des_ecb_decrypt = 0x1801f455;
define exported symbol timer_ll_set_ccr = 0x1801d22d;
define exported symbol timer_ll_pwm_dma = 0x1801d439;
define exported symbol ps_ll_set_wakeupmode = 0x1801efe9;
define exported symbol i2s_ll_clear_isr = 0x1801e775;
define exported symbol timer_ll_pwm_cmd = 0x1801d3d1;
define exported symbol timer_ll_set_polarity = 0x1801d399;
define exported symbol sci_ll_crypto_hmac_md5_process = 0x1801f55d;
define exported symbol timer_ll_get_tick = 0x1801d1f5;
define exported symbol spi_dma_tx_opt = 0x1801e319;
define exported symbol uart_ll_set_itmask = 0x1801d85d;
define exported symbol wl_ll_ps_enable = 0x1801f271;
define exported symbol ps_ll_disable = 0x1801efe5;
define exported symbol sci_ll_crypto_des_cbc_init = 0x1801f3fd;
define exported symbol sci_ll_crypto_3des_cbc_decrypt = 0x1801f405;
define exported symbol i2s_ll_dma_config = 0x1801e741;
define exported symbol uart_dma_tx_opt = 0x1801d9f9;
define exported symbol timer_ll_init_pwm = 0x1801d33d;
define exported symbol hal_ll_stady_wake = 0x1801ed95;
define exported symbol gpio_ll_write = 0x1801ce6d;
define exported symbol adc_ll_set_oneshot = 0x1801d0b1;
define exported symbol flash_ll_read = 0x1801ca79;
define exported symbol uart_ll_set_rx_thd = 0x1801d6a1;
define exported symbol int_ll_unreg = 0x1801f395;
define exported symbol timer_ll_cmd = 0x1801d25d;
define exported symbol adc_ll_mask_it = 0x1801d01d;
define exported symbol spi_ll_rx_allow = 0x1801e201;
define exported symbol uart_ll_send_byte = 0x1801d831;
define exported symbol int_ll_int_disable = 0x1801f3a9;
define exported symbol i2c_ll_deinit = 0x1801dba5;
define exported symbol pinmux_ll_swd_off = 0x1801cd85;
define exported symbol rtc_ll_alarm_clr = 0x1801ebf5;
define exported symbol pinmux_ll_config = 0x1801cd6d;
define exported symbol i2c_ll_init = 0x1801da81;
define exported symbol freertos_ll_post_sleep_processing = 0x18045e21;
define exported symbol sci_ll_crypto_des_cbc_encrypt = 0x1801f3ed;
define exported symbol i2c_ll_cmd = 0x1801db85;
define exported symbol sci_ll_crypto_hmac_sha1 = 0x1801f565;
define exported symbol c32k_ll_patch_en = 0x1801ec69;
define exported symbol rtc_ll_settime = 0x1801eb79;
define exported symbol pmu_ll_stady_wake = 0x180459f9;
define exported symbol adc_ll_read = 0x1801d06d;
define exported symbol i2s_ll_init = 0x1801e425;
define exported symbol i2c_ll_slave_write = 0x1801dc75;
define exported symbol wdg_ll_start = 0x1801edd9;
define exported symbol freertos_ll_ready_to_sleep = 0x18045ccd;
define exported symbol ps_ll_enable = 0x1801f0c9;
define exported symbol sci_ll_crypto_sha1_init = 0x1801f515;
define exported symbol rtc_ll_alarm_cmd = 0x1801ebe9;
define exported symbol i2c_ll_set_itmask = 0x1801dbc9;
define exported symbol os_ll_init = 0x1801f37d;
define exported symbol rtc_ll_selectclk = 0x1801eb71;
define exported symbol gpio_ll_deinit = 0x1801ce45;
define exported symbol sci_ll_crypto_hmac_sha2 = 0x1801f585;
define exported symbol timer_ll_clear_flag = 0x1801d169;
define exported symbol delay_ll_ms = 0x1801f3c5;
define exported symbol sci_ll_crypto_hmac_sha1_init = 0x1801f575;
define exported symbol pll_ll_cmd = 0x1801cf9d;
define exported symbol loguart_ll_deinit = 0x1801eb39;
define exported symbol i2c_ll_master_read_it = 0x1801dcfd;
define exported symbol sci_ll_crypto_sha2 = 0x1801f525;
define exported symbol i2s_ll_get_cur_page = 0x1801e695;
define exported symbol adc_ll_clr_flag = 0x1801d065;
define exported symbol adc_ll_get_flag = 0x1801d051;
define exported symbol sci_ll_crypto_aes_ecb_encrypt = 0x1801f4b5;
define exported symbol sci_ll_crypto_hmac_sha2_process = 0x1801f59d;
define exported symbol hal_ll_calib_osc8m = 0x1801f279;
define exported symbol uart_ll_dma_cmd = 0x1801d915;
define exported symbol spi_ll_write = 0x1801e245;
define exported symbol sci_ll_crypto_3des_ecb_init = 0x1801f475;
define exported symbol sci_ll_crypto_des_cbc_decrypt = 0x1801f3dd;
define exported symbol i2s_ll_init_trx_page = 0x1801e7b9;
define exported symbol i2s_ll_deinit = 0x1801e539;
define exported symbol i2s_ll_page_infor = 0x1801e6b9;
define exported symbol i2c_ll_set_slave_addr = 0x1801db65;
define exported symbol sci_ll_crypto_md5 = 0x1801f4f5;
define exported symbol i2c_ll_master_read = 0x1801dc55;
define exported symbol rtc_ll_deinit = 0x1801eb6d;
define exported symbol perion_ll_set_bits = 0x1801ed2d;
define exported symbol hal_ll_dsleep_set_timer_event = 0x1801f215;
define exported symbol sci_ll_crypto_des_ecb_init = 0x1801f44d;
define exported symbol freertos_ll_pre_sleep_processing = 0x18045cdd;
define exported symbol sci_ll_crypto_aes_ctr_decrypt = 0x1801f47d;
define exported symbol i2c_dma_tx_opt = 0x1801de09;
define exported symbol timer_ll_pwm_dma_stop = 0x1801d55d;
define exported symbol timer_ll_set_itmask = 0x1801d199;
define exported symbol i2s_ll_dma_enable = 0x1801e6ed;
define exported symbol uart_dma_ll_tx_stop = 0x1801d99d;
define exported symbol int_ll_int_enable = 0x1801f39d;
define exported symbol rtc_ll_init_alarm = 0x1801ebfd;
define exported symbol sci_ll_crypto_aes_ecb_decrypt = 0x1801f4a5;
define exported symbol i2c_ll_get_flag = 0x1801dd85;
define exported symbol wdg_ll_it_mask = 0x1801edf9;
define exported symbol gpio_ll_read = 0x1801cf25;
define exported symbol spi_ll_read = 0x1801e265;
define exported symbol i2c_ll_slavor_read_it = 0x1801dd15;
define exported symbol uart_ll_deinit = 0x1801d821;
define exported symbol int_ll_reg = 0x1801f385;
define exported symbol i2c_dma_rx_opt = 0x1801de55;
define exported symbol hal_ll_mp_handle = 0x1801f289;
define exported symbol i2s_ll_set_param = 0x1801e58d;
define exported symbol spi_ll_deinit = 0x1801e189;
define exported symbol i2c_ll_master_write_it = 0x1801dcb5;
define exported symbol sci_ll_crypto_md5_process = 0x1801f505;
define exported symbol periph_rcc_ll_cmd = 0x1801cfe1;
define exported symbol gpio_ll_irq = 0x1801f3b5;
define exported symbol rtc_ll_gettime = 0x1801eba9;
define exported symbol sci_ll_crypto_info = 0x1801f3d5;
define exported symbol gpio_ll_pull = 0x1801ced1;
define exported symbol sci_ll_crypto_aes_cbc_init = 0x1801f4ed;
define exported symbol i2s_ll_trxpage_dmaen = 0x1801e709;
define exported symbol sci_ll_crypto_sha1 = 0x1801f50d;
define exported symbol i2c_ll_clr_flag = 0x1801ddd1;
define exported symbol wdg_ll_refresh = 0x1801ede5;
